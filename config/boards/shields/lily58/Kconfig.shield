## config/boards/shields/lily58/Kconfig.shield
```kconfig
# Copyright (c) 2020 Pete Johanson
# SPDX-License-Identifier: MIT

config SHIELD_lily58_LEFT
    def_bool $(shields_list_contains,lily58_left)

config SHIELD_lily58_RIGHT
    def_bool $(shields_list_contains,lily58_right)
```

## config/boards/shields/sml58/Kconfig.shield
```kconfig
# Copyright (c) 2020 Pete Johanson
# SPDX-License-Identifier: MIT

config SHIELD_sml58_LEFT
    def_bool $(shields_list_contains,sml58_left)

config SHIELD_sml58_RIGHT
    def_bool $(shields_list_contains,sml58_right)
```
